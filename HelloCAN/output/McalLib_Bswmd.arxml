AUTOSAR XML (schema 4-2-2)
# Copyright (C) Infineon Technologies (2021)
# All rights reserved.
package /AURIX2G_McalLib/BswModuleDescriptions
  bsw module description McalLib: category=BSW_MODULE, module-id=255  # MCAL Library
    provided-entrys:
      Mcal_SetBitAtomic
      Mcal_GetBitAtomic
      Mcal_GetCpuWdgPassword
      Mcal_SetCpuWdgPassword
      Mcal_WriteCpuEndInitProtReg
      Mcal_GetSafetyEndInitPassword
      Mcal_SetSafetyEndInitPassword
      Mcal_WriteSafetyEndInitProtReg
      Mcal_WriteSafetyEndInitProtReg16
      Mcal_WriteSafetyEndInitProtRegMask
      Mcal_GetPeripheralEndInitPassword
      Mcal_SetPeripheralEndInitPassword
      Mcal_WritePeripEndInitProtReg
      Mcal_GetCpuPhysicalId
      Mcal_GetGlobalDsprAddress
      Mcal_GetLocalDsprAddress
      Mcal_GetGlobalPsprAddress
      Mcal_GetLocalPsprAddress
      Mcal_DelayTickResolution
      Mcal_DelayResetTickCalibration
      Mcal_DelayGetTick
      Mcal_GetCpuIndex
      Mcal_GetSpinlock
      Mcal_ReleaseSpinlock
      McalLib_GetVersionInfo
    bsw module dependency McalSafetyErrorDependency: target-module-id=255, required-entrys=Mcal_ReportSafetyError
    bsw internal behavior McalLibBehavior
      4 x exclusive area:
        PeripheralEndInit
        SafetyEndInit
        CpuEndInit
        StmTimerResolution
      25 x bsw called entity:
        Mcal_SetBitAtomic: reentrancy-level=MULTICORE-REENTRANT, implemented-entry=Mcal_SetBitAtomic
        Mcal_GetBitAtomic: reentrancy-level=MULTICORE-REENTRANT, implemented-entry=Mcal_GetBitAtomic
        Mcal_SetCpuWdgPassword: can-enter-exclusive-area=CpuEndInit, reentrancy-level=MULTICORE-REENTRANT, implemented-entry=Mcal_SetCpuWdgPassword
        Mcal_WriteCpuEndInitProtReg: can-enter-exclusive-area=CpuEndInit, reentrancy-level=MULTICORE-REENTRANT, implemented-entry=Mcal_WriteCpuEndInitProtReg
        Mcal_SetSafetyEndInitPassword: can-enter-exclusive-area=SafetyEndInit, reentrancy-level=NON-REENTRANT, implemented-entry=Mcal_SetSafetyEndInitPassword
        Mcal_WriteSafetyEndInitProtReg16: can-enter-exclusive-area=SafetyEndInit, reentrancy-level=NON-REENTRANT, implemented-entry=Mcal_WriteSafetyEndInitProtReg16
        Mcal_WriteSafetyEndInitProtReg: can-enter-exclusive-area=SafetyEndInit, reentrancy-level=NON-REENTRANT, implemented-entry=Mcal_WriteSafetyEndInitProtReg
        Mcal_WriteSafetyEndInitProtRegMask: can-enter-exclusive-area=SafetyEndInit, reentrancy-level=NON-REENTRANT, implemented-entry=Mcal_WriteSafetyEndInitProtRegMask
        Mcal_SetPeripheralEndInitPassword: can-enter-exclusive-area=PeripheralEndInit, reentrancy-level=NON-REENTRANT, implemented-entry=Mcal_SetPeripheralEndInitPassword
        Mcal_WritePeripEndInitProtReg: can-enter-exclusive-area=PeripheralEndInit, reentrancy-level=NON-REENTRANT, implemented-entry=Mcal_WritePeripEndInitProtReg
        Mcal_GetCpuWdgPassword: reentrancy-level=MULTICORE-REENTRANT, implemented-entry=Mcal_GetCpuWdgPassword
        Mcal_GetSafetyEndInitPassword: reentrancy-level=MULTICORE-REENTRANT, implemented-entry=Mcal_GetSafetyEndInitPassword
        Mcal_GetPeripheralEndInitPassword: reentrancy-level=MULTICORE-REENTRANT, implemented-entry=Mcal_GetPeripheralEndInitPassword
        Mcal_GetCpuPhysicalId: reentrancy-level=MULTICORE-REENTRANT, implemented-entry=Mcal_GetCpuPhysicalId
        Mcal_DelayTickResolution: reentrancy-level=MULTICORE-REENTRANT, implemented-entry=Mcal_DelayTickResolution
        McalLib_GetVersionInfo: reentrancy-level=MULTICORE-REENTRANT, implemented-entry=McalLib_GetVersionInfo
        Mcal_GetGlobalDsprAddress: reentrancy-level=MULTICORE-REENTRANT, implemented-entry=Mcal_GetGlobalDsprAddress
        Mcal_GetLocalDsprAddress: reentrancy-level=MULTICORE-REENTRANT, implemented-entry=Mcal_GetLocalDsprAddress
        Mcal_GetGlobalPsprAddress: reentrancy-level=MULTICORE-REENTRANT, implemented-entry=Mcal_GetGlobalPsprAddress
        Mcal_GetLocalPsprAddress: reentrancy-level=MULTICORE-REENTRANT, implemented-entry=Mcal_GetLocalPsprAddress
        Mcal_DelayGetTick: reentrancy-level=MULTICORE-REENTRANT, implemented-entry=Mcal_DelayGetTick
        Mcal_GetCpuIndex: reentrancy-level=MULTICORE-REENTRANT, implemented-entry=Mcal_GetCpuIndex
        Mcal_GetSpinlock: reentrancy-level=NON-REENTRANT, implemented-entry=Mcal_GetSpinlock
        Mcal_ReleaseSpinlock: reentrancy-level=NON-REENTRANT, implemented-entry=Mcal_ReleaseSpinlock
        Mcal_DelayResetTickCalibration: can-enter-exclusive-area=StmTimerResolution, reentrancy-level=NON-REENTRANT, implemented-entry=Mcal_DelayResetTickCalibration
package /AURIX2G_McalLib/BswModuleEntrys
  25 x bsw module entry, all with is-synchronous=true, call-type=REGULAR:
    Mcal_GetCpuWdgPassword: service-id=136, is-reentrant=true, execution-context=UNSPECIFIED, sw-service-impl-policy=STANDARD
      return type Return: implementation-data-type=uint32
    Mcal_SetCpuWdgPassword: service-id=133, is-reentrant=true, execution-context=UNSPECIFIED, sw-service-impl-policy=STANDARD
      return type Return: implementation-data-type=uint32
      sw service arg Password: implementation-data-type=uint32
    Mcal_WriteCpuEndInitProtReg: service-id=126, is-reentrant=true, execution-context=UNSPECIFIED, sw-service-impl-policy=STANDARD
      sw service arg DataValue: implementation-data-type=uint32
      sw service arg RegAddress: category=DATA_REFERENCE, sw-pointer-target-props={target-category=TYPE_REFERENCE, implementation-data-type=void}
    Mcal_GetSafetyEndInitPassword: service-id=135, is-reentrant=true, execution-context=UNSPECIFIED, sw-service-impl-policy=STANDARD
      return type Return: implementation-data-type=uint32
    Mcal_SetSafetyEndInitPassword: service-id=128, is-reentrant=false, execution-context=UNSPECIFIED, sw-service-impl-policy=STANDARD
      return type Return: implementation-data-type=uint32
      sw service arg Password: implementation-data-type=uint32
    Mcal_WriteSafetyEndInitProtReg: service-id=127, is-reentrant=false, execution-context=UNSPECIFIED, sw-service-impl-policy=STANDARD
      sw service arg DataValue: implementation-data-type=uint32
      sw service arg RegAddress: category=DATA_REFERENCE, sw-pointer-target-props={target-category=TYPE_REFERENCE, implementation-data-type=void}
    Mcal_WriteSafetyEndInitProtReg16: service-id=129, is-reentrant=false, execution-context=UNSPECIFIED, sw-service-impl-policy=STANDARD
      sw service arg DataValue: implementation-data-type=uint16
      sw service arg RegAddress: category=DATA_REFERENCE, sw-pointer-target-props={target-category=TYPE_REFERENCE, implementation-data-type=void}
    Mcal_WriteSafetyEndInitProtRegMask: service-id=143, is-reentrant=false, execution-context=UNSPECIFIED, sw-service-impl-policy=STANDARD
      sw service arg DataValue: implementation-data-type=uint32
      sw service arg Mask: implementation-data-type=uint32
      sw service arg RegAddress: category=DATA_REFERENCE, sw-pointer-target-props={target-category=TYPE_REFERENCE, implementation-data-type=void}
    Mcal_GetPeripheralEndInitPassword: service-id=130, is-reentrant=true, execution-context=UNSPECIFIED, sw-service-impl-policy=STANDARD
      return type Return: implementation-data-type=uint32
    Mcal_SetPeripheralEndInitPassword: service-id=124, is-reentrant=false, execution-context=UNSPECIFIED, sw-service-impl-policy=STANDARD
      return type Return: implementation-data-type=uint32
      sw service arg Password: implementation-data-type=uint32
    Mcal_WritePeripEndInitProtReg: service-id=122, is-reentrant=false, execution-context=UNSPECIFIED, sw-service-impl-policy=STANDARD
      sw service arg DataValue: implementation-data-type=uint32
      sw service arg RegAddress: category=DATA_REFERENCE, sw-pointer-target-props={target-category=TYPE_REFERENCE, implementation-data-type=void}
    Mcal_GetCpuPhysicalId: service-id=139, is-reentrant=true, execution-context=UNSPECIFIED, sw-service-impl-policy=STANDARD
      return type Return: implementation-data-type=uint32
    Mcal_GetGlobalDsprAddress: service-id=123, is-reentrant=true, execution-context=UNSPECIFIED, sw-service-impl-policy=STANDARD
      return type Return: implementation-data-type=uint32
      sw service arg CpuId: implementation-data-type=uint32
      sw service arg LocalDsprAddress: implementation-data-type=uint32
    Mcal_GetLocalDsprAddress: service-id=131, is-reentrant=true, execution-context=UNSPECIFIED, sw-service-impl-policy=STANDARD
      return type Return: implementation-data-type=uint32
      sw service arg GlobalDsprAddress: implementation-data-type=uint32
    Mcal_GetGlobalPsprAddress: service-id=125, is-reentrant=true, execution-context=UNSPECIFIED, sw-service-impl-policy=STANDARD
      return type Return: implementation-data-type=uint32
      sw service arg CpuId: implementation-data-type=uint32
      sw service arg LocalPsprAddress: implementation-data-type=uint32
    Mcal_GetLocalPsprAddress: service-id=132, is-reentrant=true, execution-context=UNSPECIFIED, sw-service-impl-policy=STANDARD
      return type Return: implementation-data-type=uint32
      sw service arg GlobalPsprAddress: implementation-data-type=uint32
    Mcal_DelayTickResolution: service-id=140, is-reentrant=true, execution-context=UNSPECIFIED, sw-service-impl-policy=STANDARD
      return type Return: implementation-data-type=uint32
    Mcal_DelayResetTickCalibration: service-id=134, is-reentrant=false, execution-context=UNSPECIFIED, sw-service-impl-policy=STANDARD
      return type Return: implementation-data-type=uint32
    Mcal_DelayGetTick: service-id=138, is-reentrant=true, execution-context=UNSPECIFIED, sw-service-impl-policy=STANDARD
      return type Return: implementation-data-type=uint32
    Mcal_GetCpuIndex: service-id=137, is-reentrant=true, execution-context=UNSPECIFIED, sw-service-impl-policy=STANDARD
      return type Return: implementation-data-type=uint32
      sw service arg CpuId: implementation-data-type=uint32
    McalLib_GetVersionInfo: service-id=121, is-reentrant=true, execution-context=TASK, sw-service-impl-policy=STANDARD
      sw service arg versioninfo: category=DATA_REFERENCE, sw-pointer-target-props={target-category=TYPE_REFERENCE, implementation-data-type=Std_VersionInfoType}
    Mcal_GetSpinlock: service-id=141, is-reentrant=false, execution-context=UNSPECIFIED, sw-service-impl-policy=STANDARD
      sw service arg Mcal_LockAddress: category=DATA_REFERENCE, sw-pointer-target-props={target-category=TYPE_REFERENCE, implementation-data-type=uint32}
    Mcal_ReleaseSpinlock: service-id=142, is-reentrant=false, execution-context=UNSPECIFIED, sw-service-impl-policy=STANDARD
      sw service arg Mcal_LockAddress: category=DATA_REFERENCE, sw-pointer-target-props={target-category=TYPE_REFERENCE, implementation-data-type=uint32}
    Mcal_SetBitAtomic: is-reentrant=true, execution-context=UNSPECIFIED, sw-service-impl-policy=MACRO
      4 x sw service arg:
        DataPtr: category=DATA_REFERENCE, sw-pointer-target-props={target-category=TYPE_REFERENCE, implementation-data-type=uint32}
        BitPos: implementation-data-type=uint8
        BitLen: implementation-data-type=uint8
        Data: implementation-data-type=uint32
    Mcal_GetBitAtomic: is-reentrant=true, execution-context=UNSPECIFIED, sw-service-impl-policy=MACRO
      sw service arg DataValue: implementation-data-type=uint32
      sw service arg BitPos: implementation-data-type=uint8
      sw service arg BitLen: implementation-data-type=uint8
package /AURIX2G_McalLib/Implementations
  bsw implementation McalLib: programming-language=C, sw-version=20.10.0, vendor-id=17, ar-release-version=4.2.2, behavior=McalLibBehavior, vendor-specific-module-def=McalLib
    code-descriptors:
      code Files
        artifact-descriptors:
          short-label=Tricore::ssc::src::McalLib.c, category=SWSRC
          short-label=Tricore::ssc::inc::McalLib.h, category=SWHDR
    generated-artifacts:
      dependency on artifact McalLib_Cfg_h: artifact-descriptor={short-label=generate::template::inc::McalLib_Cfg.h, category=SWTEMPLATE}, usages=COMPILE
      dependency on artifact McalLib_xdm: artifact-descriptor={short-label=config::McalLib.xdm, category=SWTOOL}, usages=CODEGENERATION
      dependency on artifact McalLib_bmd: artifact-descriptor={short-label=autosar::TC33x::TC334x::McalLib.bmd, category=SWTOOL}, usages=CODEGENERATION
    resource consumption ResourceConsumption
      4 x memory section:
        CONST_ASIL_B_GLOBAL_8: alignment=8, sw-addrmethod=CONST
        VAR_CLEARED_ASIL_B_GLOBAL_32: alignment=32, sw-addrmethod=VAR_CLEARED
        CONST_ASIL_B_GLOBAL_32: alignment=32, sw-addrmethod=CONST
        CODE_ASIL_B_GLOBAL: alignment=UNSPECIFIED, sw-addrmethod=CODE
      section name prefix MCALLIB
package /AURIX2G_McalLib/ImplementationDataTypes
  impl type unsigned_int: category=VALUE, base-type=UnsignedInt, range raw 0..4294967295, type-emitter=BSW
package /AURIX2G_McalLib/ImplementationDataTypes/BaseTypes
  base type UnsignedInt: category=FIXED_LENGTH, base-type-size=32, base-type-encoding=NONE, byte-order=little-endian, native-declaration=unsigned int
