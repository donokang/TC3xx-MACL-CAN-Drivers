AUTOSAR XML (schema 4-2-2)
# Copyright (C) Infineon Technologies (2022)
# All rights reserved.
package /AUTOSAR_Can_17_McmCan/BswModuleDescriptions
  bsw module description Can: category=BSW_MODULE, module-id=80  # CAN Driver
    provided-entrys:
      Can_Init
      Can_CheckBaudrate
      Can_SetBaudrate
      Can_SetControllerMode
      Can_DisableControllerInterrupts
      Can_EnableControllerInterrupts
      Can_Write
      Can_MainFunction_Write_0
      Can_MainFunction_Write_1
      Can_MainFunction_Mode
      Can_MainFunction_Read_0
      Can_MainFunction_Read_1
      Can_MainFunction_BusOff
      Can_MainFunction_Wakeup
      Can_GetVersionInfo
    bsw module dependency CanIfDependency: target-module-id=60
      required-entrys:
        CanIf_RxIndication
        CanIf_ControllerBusOff
        CanIf_TxConfirmation
        CanIf_CurrentIcomConfiguration
        CanIf_ControllerModeIndication
    bsw module dependency McalLibDependency: target-module-id=255
      required-entrys:
        Mcal_GetCpuIndex
        Mcal_WritePeripEndInitProtReg
        Mcal_SetBitAtomic
        Mcal_DelayTickResolution
        Mcal_DelayGetTick
    bsw internal behavior CanBehavior
      exclusive area IcomMsgCntrVal
      exclusive area CanWrMO
      8 x bsw called entity:
        Can_Init: reentrancy-level=NON-REENTRANT, implemented-entry=Can_Init
        Can_CheckBaudrate: reentrancy-level=MULTICORE-REENTRANT, implemented-entry=Can_CheckBaudrate
        Can_SetBaudrate: reentrancy-level=MULTICORE-REENTRANT, implemented-entry=Can_SetBaudrate
        Can_DisableControllerInterrupts: reentrancy-level=MULTICORE-REENTRANT, implemented-entry=Can_DisableControllerInterrupts
        Can_EnableControllerInterrupts: reentrancy-level=MULTICORE-REENTRANT, implemented-entry=Can_EnableControllerInterrupts
        Can_Write: can-enter-exclusive-area=CanWrMO, reentrancy-level=MULTICORE-REENTRANT, runs-inside-exclusive-area=CanWrMO, implemented-entry=Can_Write
        Can_SetControllerMode: reentrancy-level=NON-REENTRANT, implemented-entry=Can_SetControllerMode
        Can_GetVersionInfo: reentrancy-level=MULTICORE-REENTRANT, implemented-entry=Can_GetVersionInfo
      7 x bsw schedulable entity, all with minimum-start-interval=0.005, reentrancy-level=NON-REENTRANT:
        Can_MainFunction_Write_0: implemented-entry=Can_MainFunction_Write_0
        Can_MainFunction_Write_1: implemented-entry=Can_MainFunction_Write_1
        Can_MainFunction_Read_0: can-enter-exclusive-area=IcomMsgCntrVal, implemented-entry=Can_MainFunction_Read_0
        Can_MainFunction_Read_1: can-enter-exclusive-area=IcomMsgCntrVal, implemented-entry=Can_MainFunction_Read_1
        Can_MainFunction_BusOff: implemented-entry=Can_MainFunction_BusOff
        Can_MainFunction_Wakeup: can-enter-exclusive-area=IcomMsgCntrVal, implemented-entry=Can_MainFunction_Wakeup
        Can_MainFunction_Mode: implemented-entry=Can_MainFunction_Mode
      7 x bsw timing event:
        TimingEvent_Can_17_McmCan_MainFunction_Mode: starts-on-event=Can_MainFunction_Mode, period=0.005
        TimingEvent_Can_17_McmCan_MainFunction_BusOff: starts-on-event=Can_MainFunction_BusOff, period=0.005
        TimingEvent_Can_17_McmCan_MainFunction_Wakeup: starts-on-event=Can_MainFunction_Wakeup, period=0.005
        TimingEvent_Can_17_McmCan_MainFunction_Read_0: starts-on-event=Can_MainFunction_Read_0, period=0.001
        TimingEvent_Can_17_McmCan_MainFunction_Read_1: starts-on-event=Can_MainFunction_Read_1, period=0.005
        TimingEvent_Can_17_McmCan_MainFunction_Write_0: starts-on-event=Can_MainFunction_Write_0, period=0.001
        TimingEvent_Can_17_McmCan_MainFunction_Write_1: starts-on-event=Can_MainFunction_Write_1, period=0.005
package /AUTOSAR_Can_17_McmCan/BswModuleEntrys
  15 x bsw module entry, all with is-synchronous=true, execution-context=TASK, sw-service-impl-policy=STANDARD:
    Can_Init: service-id=0, is-reentrant=false, call-type=REGULAR
      sw service arg Config: category=DATA_REFERENCE, sw-pointer-target-props={target-category=TYPE_REFERENCE, implementation-data-type=Can_17_McmCan_ConfigType}
    Can_SetControllerMode: service-id=3, is-reentrant=false, call-type=REGULAR
      return type Return: implementation-data-type=Can_ReturnType
      sw service arg Controller: implementation-data-type=uint8
      sw service arg Transition: implementation-data-type=Can_StateTransitionType
    Can_DisableControllerInterrupts: service-id=4, is-reentrant=true, call-type=REGULAR
      sw service arg Controller: implementation-data-type=uint8
    Can_EnableControllerInterrupts: service-id=5, is-reentrant=true, call-type=REGULAR
      sw service arg Controller: implementation-data-type=uint8
    Can_CheckBaudrate: service-id=14, is-reentrant=true, call-type=REGULAR
      sw service arg Controller: implementation-data-type=uint8
      sw service arg Baudrate: implementation-data-type=uint16
    Can_SetBaudrate: service-id=15, is-reentrant=true, call-type=REGULAR
      sw service arg Controller: implementation-data-type=uint8
      sw service arg BaudRateConfigID: implementation-data-type=uint16
    Can_GetVersionInfo: service-id=7, is-reentrant=true, call-type=REGULAR
      sw service arg versioninfo: category=DATA_REFERENCE, sw-pointer-target-props={target-category=TYPE_REFERENCE, implementation-data-type=Std_VersionInfoType}
    Can_Write: service-id=6, is-reentrant=true, call-type=REGULAR
      return type Return: implementation-data-type=Can_ReturnType
      sw service arg Hth: implementation-data-type=Can_HwHandleType
      sw service arg PduInfo: category=DATA_REFERENCE, sw-pointer-target-props={target-category=TYPE_REFERENCE, implementation-data-type=Can_PduType}
    Can_MainFunction_Wakeup: service-id=10, is-reentrant=false, call-type=SCHEDULED
    Can_MainFunction_BusOff: service-id=9, is-reentrant=false, call-type=SCHEDULED
    Can_MainFunction_Mode: service-id=12, is-reentrant=false, call-type=SCHEDULED
    Can_MainFunction_Read_0: role=Can_MainFunction_Read_0, is-reentrant=false, call-type=SCHEDULED
    Can_MainFunction_Read_1: role=Can_MainFunction_Read_1, is-reentrant=false, call-type=SCHEDULED
    Can_MainFunction_Write_0: role=Can_MainFunction_Write_0, is-reentrant=false, call-type=SCHEDULED
    Can_MainFunction_Write_1: role=Can_MainFunction_Write_1, is-reentrant=false, call-type=SCHEDULED
package /AUTOSAR_Can_17_McmCan/Implementations
  bsw implementation Can: programming-language=C, sw-version=20.20.0, vendor-id=17, ar-release-version=4.2.2, behavior=CanBehavior, vendor-api-infix=McmCan, vendor-specific-module-def=Can
    code-descriptors:
      code Files
        artifact-descriptors:
          short-label=ssc::inc::Can_17_McmCan.h, category=SWHDR
          short-label=ssc::src::Can_17_McmCan.c, category=SWSRC
    generated-artifacts:
      5 x dependency on artifact:
        Can_Cfg_h: artifact-descriptor={short-label=generate::inc:Can_17_McmCan_Cfg.h, category=SWTEMPLATE}, usages=COMPILE
        Can_PBcfg_h: artifact-descriptor={short-label=generate::template::inc::Can_17_McmCan_PBcfg.h, category=SWTEMPLATE}, usages=EXECUTE
        Can_PBCfg_c: artifact-descriptor={short-label=generate::src::Can_17_McmCan_PBcfg.c, category=SWTEMPLATE}, usages=EXECUTE
        Can_xdm: artifact-descriptor={short-label=config::Can_17_McmCan.xdm, category=SWTOOL}, usages=CODEGENERATION
        Can_bmd: artifact-descriptor={short-label=autosar::TC33x::TC334x::Can_17_McmCan.bmd, category=SWTOOL}, usages=CODEGENERATION
    resource consumption ResourceConsumption
      8 x memory section, all with alignment=UNSPECIFIED:
        VAR_CLEARED_QM_CORE0_UNSPECIFIED: sw-addrmethod=VAR_CLEARED
        VAR_INIT_QM_CORE0_UNSPECIFIED: sw-addrmethod=VAR_INIT
        VAR_CLEARED_QM_GLOBAL_UNSPECIFIED: sw-addrmethod=VAR_CLEARED
        CONST_QM_GLOBAL_UNSPECIFIED: sw-addrmethod=CONST
        CONST_QM_CORE0_UNSPECIFIED: sw-addrmethod=CONST
        CONFIG_DATA_QM_GLOBAL_UNSPECIFIED: sw-addrmethod=CONFIG_DATA
        CONFIG_DATA_QM_CORE0_UNSPECIFIED: sw-addrmethod=CONFIG_DATA
        CODE_QM_GLOBAL: sw-addrmethod=CODE
      section name prefix CAN_17_MCMCAN
package /AUTOSAR_Can_17_McmCan/ImplementationDataTypes
  30 x impl type, all with type-emitter=BSW:
    Can_17_McmCan_LPduRxCalloutFnPtrType: category=FUNCTION_REFERENCE, sw-pointer-target-props=Can_LpduCallout
    Can_17_Mcmcan_DrvStateMachine: compu {0=CAN_17_MCMCA_UNINIT, 1=CAN_17_MCMCAN_READY}, implementation-data-type=uint32, additional-native-type-qualifier=enum
    Can_17_McmCan_EventIndicesType: compu {0=CAN_17_MCMCAN_TX_PROCESSING_MODE, 1=CAN_17_MCMCAN_RX_PROCESSING_MODE, 2=CAN_17_MCMCAN_BO_PROCESSING_MODE, 3=CAN_17_MCMCAN_WU_PROCESSING_MODE}, implementation-data-type=uint32, additional-native-type-qualifier=enum
    Can_17_McmCan_IDType: compu {0=CAN_17_MCMCAN_ID_STANDARD, 1=CAN_17_MCMCAN_ID_MIXED, 2=CAN_17_MCMCAN_ID_EXTENDED}, implementation-data-type=uint32, additional-native-type-qualifier=enum
    Can_17_McmCan_MOMapType: compu {0=CAN_17_MCMCAN_TX_STARTINDEX, 1=CAN_17_MCMCAN_TX_TOTAL_MSGCFG, 2=CAN_17_MCMCAN_RX_SID_STARTINDEX, 3=CAN_17_MCMCAN_TOTAL_SIDCFG, 4=CAN_17_MCMCAN_RX_XID_STARTINDEX, 5=CAN_17_MCMCAN_TOTAL_XIDCFG}, implementation-data-type=uint32, additional-native-type-qualifier=enum
    Can_17_McmCan_MsgRamMapType: compu {0=CAN_17_MCMCAN_FLSSA, 1=CAN_17_MCMCAN_FLSEA, 2=CAN_17_MCMCAN_F0SA, 3=CAN_17_MCMCAN_F1SA, 4=CAN_17_MCMCAN_RBSA, 5=CAN_17_MCMCAN_EFSA, 6=CAN_17_MCMCAN_TBSA}, implementation-data-type=uint32, additional-native-type-qualifier=enum
    Can_17_McmCan_ProcessingType: compu {0=CAN_17_MCMCAN_POLLING, 1=CAN_17_MCMCAN_INTERRUPT, 2=CAN_17_MCMCAN_MIXED}, implementation-data-type=uint32, additional-native-type-qualifier=enum
    Can_17_McmCan_RxFIFOProcessingType: compu {0=CAN_17_MCMCAN_RX_FIFO_POLLING, 1=CAN_17_MCMCAN_RX_FIFO_INTERRUPT, 2=CAN_17_MCMCAN_RX_FIFO_NOT_CONFIGURED}, implementation-data-type=uint32, additional-native-type-qualifier=enum
    Can_17_McmCan_TxBufferType: compu {0=CAN_17_MCMCAN_TX_DED_BUFFER, 1=CAN_17_MCMCAN_TX_QUEUE}, implementation-data-type=uint32, additional-native-type-qualifier=enum
    Can_17_McmCan_RxBufferType: compu {0=CAN_17_MCMCAN_RX_DED_BUFFER, 1=CAN_17_MCMCAN_RX_FIFO0, 2=CAN_17_MCMCAN_RX_FIFO1, 3=CAN_17_MCMCAN_RX_ALL}, implementation-data-type=uint32, additional-native-type-qualifier=enum
    Can_17_McmCan_IcomSignalOperType: compu {0=CAN_17_MCMCAN_ICOM_OPER_AND, 1=CAN_17_MCMCAN_ICOM_OPER_EQUAL, 2=CAN_17_MCMCAN_ICOM_OPER_GREATER, 3=CAN_17_MCMCAN_ICOM_OPER_SMALLER, 4=CAN_17_MCMCAN_ICOM_OPER_XOR}, implementation-data-type=uint32, additional-native-type-qualifier=enum
    Can_17_McmCan_ControllerBaudrateConfigType: category=STRUCTURE
      4 x element, all with category=TYPE_REFERENCE:
        CanBaudrateCfg: implementation-data-type=uint16
        CanControllerBaudrate: implementation-data-type=uint32
        CanFDIndex: implementation-data-type=uint16
        CanFdConfigEnabled: implementation-data-type=boolean
    Can_17_McmCan_McmModuleConfigType: category=STRUCTURE
      element CanBaseAddressPtr: implementation-data-type=uint32
      element CanUsedHwCfgIndx: array-size=4, array-size-semantics=FIXED-SIZE, implementation-data-type=boolean
    Can_17_McmCan_ControllerMsgRAMConfigType: category=STRUCTURE
      7 x element, all with category=TYPE_REFERENCE:
        CanControllerMsgRAMMap: array-size=7, array-size-semantics=FIXED-SIZE, implementation-data-type=uint32
        CanTxDedBuffCount: implementation-data-type=uint8
        CanTxEvntFIFOSize: implementation-data-type=uint8
        CanRxFIFO0Size: implementation-data-type=uint8
        CanRxFIFO0Threshold: implementation-data-type=uint8
        CanRxFIFO1Size: implementation-data-type=uint8
        CanRxFIFO1Threshold: implementation-data-type=uint8
    Can_17_McmCan_ControllerFDBaudrateConfigType: category=STRUCTURE
      element CanControllerFDBaudrate: implementation-data-type=uint32
      element CanTrcvDelyComp: implementation-data-type=uint32
      element CanTxBRSEnable: implementation-data-type=boolean
    Can_17_McmCan_SIDFilterConfigType: category=STRUCTURE
      4 x element, all with category=TYPE_REFERENCE:
        CanSIDFiltEleS0: implementation-data-type=uint32
        CanSidHwObjId: implementation-data-type=Can_HwHandleType
        HwControllerId: implementation-data-type=uint8
        CanSidBufferType: implementation-data-type=Can_17_McmCan_RxBufferType
    Can_17_McmCan_XIDFilterConfigType: category=STRUCTURE
      5 x element, all with category=TYPE_REFERENCE:
        CanXIDFiltEleF0: implementation-data-type=uint32
        CanXIDFiltEleF1: implementation-data-type=uint32
        CanXidHwObjId: implementation-data-type=Can_HwHandleType
        HwControllerId: implementation-data-type=uint8
        CanXidBufferType: implementation-data-type=Can_17_McmCan_RxBufferType
    Can_17_McmCan_TxHwObjectConfigType: category=STRUCTURE
      7 x element, all with category=TYPE_REFERENCE:
        CanTxHwObjId: implementation-data-type=Can_HwHandleType
        CanTxBuffIndx: implementation-data-type=uint8
        HwControllerId: implementation-data-type=uint8
        CanFdPaddValue: implementation-data-type=uint8
        CanTxHwObjIdType: implementation-data-type=uint8
        CanTxBufferType: implementation-data-type=Can_17_McmCan_TxBufferType
        CanTrigTxStatus: implementation-data-type=boolean
    Can_17_McmCan_EventHandlingType: category=STRUCTURE
      4 x element, all with category=TYPE_REFERENCE, implementation-data-type=Can_17_McmCan_ProcessingType:
        CanTxProcessing
        CanRxProcessing
        CanBusoffProcessing
        CanWakeupProcessing
    Can_17_McmCan_HthMaskObjectConfigType: category=STRUCTURE
      element CanTxBufferMaskvalue: implementation-data-type=uint32
      element CanPerHthHwObjId: implementation-data-type=Can_HwHandleType
      element HwControllerId: implementation-data-type=uint8
    Can_17_McmCan_HrhMaskObjectConfigType: category=STRUCTURE
      5 x element, all with category=TYPE_REFERENCE:
        CanPerRxbufferMaskvalue0: implementation-data-type=uint32
        CanPerRxbufferMaskvalue1: implementation-data-type=uint32
        CanPerHrhHwObjId: implementation-data-type=Can_HwHandleType
        HwControllerId: implementation-data-type=uint8
        CanPerHrhBufferType: implementation-data-type=Can_17_McmCan_RxBufferType
    Can_17_McmCan_ControllerConfigType: category=STRUCTURE
      16 x element, all with category=TYPE_REFERENCE:
        CanNodeAddressPtr: implementation-data-type=uint32
        CanNPCRValue: implementation-data-type=uint32
        CanControllerMOMap: array-size=6, array-size-semantics=FIXED-SIZE, implementation-data-type=uint16
        CanDefaultBRCfgIndx: implementation-data-type=uint16
        CanBaudrateCfgIndx: implementation-data-type=uint16
        CanNoOfBaudrateCfg: implementation-data-type=uint16
        CanKernelHwId: implementation-data-type=uint8
        CanControllerHwId: implementation-data-type=uint8
        CanControllerLogicalId: implementation-data-type=uint8
        CanFDSupport: implementation-data-type=boolean
        CanRxFIFO0ProcessingConfig: implementation-data-type=Can_17_McmCan_RxFIFOProcessingType
        CanRxFIFO1ProcessingConfig: implementation-data-type=Can_17_McmCan_RxFIFOProcessingType
        CanHrhNDAT1PollingMask: implementation-data-type=uint32
        CanHrhNDAT2PollingMask: implementation-data-type=uint32
        CanTxPollingObjectMask: implementation-data-type=uint32
        CanEnableInterruptMask: implementation-data-type=uint32
    Can_17_McmCan_ControllerIndexType: implementation-data-type=uint8
    Can_17_McmCan_HthPeriodIndexType: implementation-data-type=uint8
    Can_17_McmCan_HrhPeriodIndexType: implementation-data-type=uint8
    Can_17_McmCan_HthIndexType: category=STRUCTURE
      element CanHthCoreAssigned: implementation-data-type=uint8
      element CanHthLogicContIndex: implementation-data-type=uint8
      element CanHthCoreSpecIndex: implementation-data-type=uint16
    Can_17_McmCan_LogicalControllerIndexType: category=STRUCTURE
      4 x element, all with category=TYPE_REFERENCE, implementation-data-type=uint8:
        CanLCoreAssigned
        CanLCoreSpecContIndex
        CanLContPhyIndex
        CanLKerPhyIndex
    Can_17_McmCan_PhyControllerIndexType: category=STRUCTURE
      element CanPLogicContIndex: implementation-data-type=uint8
      element CanPCoreSpecContIndex: implementation-data-type=uint8
      element CanPCoreAssigned: implementation-data-type=uint8
    Can_17_McmCan_CoreConfigType: category=STRUCTURE
      10 x element:
        CanCoreContCnt: implementation-data-type=uint8
        CanControllerIndexingPtr: category=DATA_REFERENCE, sw-pointer-target-props={target-category=TYPE_REFERENCE, implementation-data-type=Can_17_McmCan_ControllerIndexType}
        CanControllerConfigPtr: category=DATA_REFERENCE, sw-pointer-target-props={target-category=TYPE_REFERENCE, implementation-data-type=Can_17_McmCan_ControllerConfigType}
        CanControllerMsgRAMMapConfigPtr: category=DATA_REFERENCE, sw-pointer-target-props={target-category=TYPE_REFERENCE, implementation-data-type=Can_17_McmCan_ControllerMsgRAMConfigType}
        CanEventHandlingConfigPtr: category=DATA_REFERENCE, sw-pointer-target-props={target-category=TYPE_REFERENCE, implementation-data-type=Can_17_McmCan_EventHandlingType}
        CanBaudrateConfigPtr: category=DATA_REFERENCE, sw-pointer-target-props={target-category=TYPE_REFERENCE, implementation-data-type=Can_17_McmCan_ControllerBaudrateConfigType}
        CanFDConfigParamPtr: category=DATA_REFERENCE, sw-pointer-target-props={target-category=TYPE_REFERENCE, implementation-data-type=Can_17_McmCan_ControllerFDBaudrateConfigType}
        CanTxHwObjectConfigPtr: category=DATA_REFERENCE, sw-pointer-target-props={target-category=TYPE_REFERENCE, implementation-data-type=Can_17_McmCan_TxHwObjectConfigType}
        CanSIDFilterConfigPtr: category=DATA_REFERENCE, sw-pointer-target-props={target-category=TYPE_REFERENCE, implementation-data-type=Can_17_McmCan_SIDFilterConfigType}
        CanXIDFilterConfigPtr: category=DATA_REFERENCE, sw-pointer-target-props={target-category=TYPE_REFERENCE, implementation-data-type=Can_17_McmCan_XIDFilterConfigType}
    Can_17_McmCan_ConfigType: category=STRUCTURE
      9 x element:
        CanCoreConfigPtr: category=DATA_REFERENCE, array-size=1, array-size-semantics=FIXED-SIZE, sw-pointer-target-props={target-category=TYPE_REFERENCE, implementation-data-type=Can_17_McmCan_CoreConfigType}
        CanNoOfKernel: implementation-data-type=uint8
        CanNoOfHrh: implementation-data-type=Can_HwHandleType
        CanTotalHwObj: implementation-data-type=Can_HwHandleType
        CanMCMModuleConfigPtr: category=DATA_REFERENCE, sw-pointer-target-props={target-category=TYPE_REFERENCE, implementation-data-type=Can_17_McmCan_McmModuleConfigType}
        CanPhyControllerIndexPtr: category=DATA_REFERENCE, sw-pointer-target-props={target-category=TYPE_REFERENCE, implementation-data-type=Can_17_McmCan_PhyControllerIndexType}
        CanLogicalControllerIndexPtr: category=DATA_REFERENCE, sw-pointer-target-props={target-category=TYPE_REFERENCE, implementation-data-type=Can_17_McmCan_LogicalControllerIndexType}
        CanHthIndexPtr: category=DATA_REFERENCE, sw-pointer-target-props={target-category=TYPE_REFERENCE, implementation-data-type=Can_17_McmCan_HthIndexType}
        CanLPduRxCalloutFuncPtr: implementation-data-type=Can_17_McmCan_LPduRxCalloutFnPtrType
